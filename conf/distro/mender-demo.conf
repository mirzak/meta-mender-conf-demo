## conf/distro/mender-demo.conf
```bitbake
require conf/distro/poky.conf

DISTRO = "mender-demo"
DISTRO_NAME = "Mender Conference Demo"

MAINTAINER = "Mirza Krak <mirza.krak@northern.tech>"

PACKAGE_CLASSES = "package_ipk"

INHERIT += "rm_work"

IMAGE_FEATURES_append = " ssh-server-dropbear splash read-only-rootfs"

IMAGE_INSTALL_append = " image-display"

IMAGE_DISPLAY_IMAGE_FILE ?= "demo-image-1.png"
MENDER_ARTIFACT_NAME ?= "demo-image-1"

IMAGE_INSTALL_append = " haveged image-display mender-binary-delta"

LICENSE_FLAGS_WHITELIST = "commercial_mender-binary-delta"
FILESEXTRAPATHS_prepend_pn-mender-binary-delta := "${HOME}/mender-binary-delta-1.0.0b1/:"

MENDER_DEMO_HOST_IP_ADDRESS = "192.168.1.120"

IMAGE_FSTYPES_append = " sdimg.gz"

########################### Artifact Size ######################################

# Explicitly set this to zero as it might sneak in depending on what we include.
IMAGE_ROOTFS_EXTRA_SPACE = "0"

# If we set this to zero we rely completely on IMAGE_OVERHEAD_FACTOR.
IMAGE_ROOTFS_SIZE = "0"

# This will make sure that we a relative amount of extra free space on rootfs.
# 1.5 means that we will have 50 % extra free space added.
IMAGE_OVERHEAD_FACTOR = "1.3"

########################### Raspberry Pi #######################################

MENDER_STORAGE_TOTAL_SIZE_MB_DEFAULT_raspberrypi3 = "2048"

ENABLE_UART_raspberrypi3 = "1"
```

## conf/layer.conf
```bitbake
# We have a conf and classes directory, add to BBPATH
BBPATH .= ":${LAYERDIR}"

# We have recipes-* directories, add to BBFILES
BBFILES += "${LAYERDIR}/recipes-*/*/*.bb \
	${LAYERDIR}/recipes-*/*/*.bbappend"

# Let us add layer-specific bbappends which are only applied when that
# layer is included in our configuration
BBFILES += "${@' '.join('${LAYERDIR}/%s/recipes*/*/*.bbappend' % layer \
               for layer in BBFILE_COLLECTIONS.split())}"

BBFILES_DYNAMIC += " \
    raspberrypi:${LAYERDIR}/dynamic-layers/raspberrypi/*/*/*.bb \
    raspberrypi:${LAYERDIR}/dynamic-layers/raspberrypi/*/*/*.bbappend \
"

BBFILE_COLLECTIONS += "meta-mender-conf-demo"
BBFILE_PATTERN_meta-mender-conf-demo = "^${LAYERDIR}/"
BBFILE_PRIORITY_meta-mender-conf-demo = "15"

LAYERSERIES_COMPAT_meta-mender-conf-demo = "sumo thud warrior zeus"
```
